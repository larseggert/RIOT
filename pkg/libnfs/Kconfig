## pkg/libnfs/Kconfig
```kconfig
# Copyright (c) 2021 HAW Hamburg
#
# This file is subject to the terms and conditions of the GNU Lesser
# General Public License v2.1. See the file LICENSE in the top level
# directory for more details.
#

config PACKAGE_LIBNFS
    bool "LIBNFS"
    depends on TEST_KCONFIG
#    depends on HAS_ARCH_32BIT
    help
        LIBNFS is a client library for accessing NFS shares over a network.
```

## pkg/msquic/Kconfig
```kconfig
config PACKAGE_MSQUIC
    bool "Cross-platform, C implementation of the IETF QUIC protocol"
#    depends on TEST_KCONFIG
#    depends on HAS_ARCH_32BIT
```
